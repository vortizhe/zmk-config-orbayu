## boards/shields/orbayu/Kconfig.defconfig
```kconfig
if SHIELD_ORBAYU_RIGHT

config SPI
    default y

config ZMK_POINTING
    default y

config PAW3222
    default y

endif # SHIELD_ORBAYU_RIGHT

if SHIELD_ORBAYU_LEFT || SHIELD_ORBAYU_RIGHT

config ZMK_SPLIT
    default y

config RGBLED_WIDGET_BATTERY_LEVEL_HIGH
    default 30

config RGBLED_WIDGET_BATTERY_LEVEL_CRITICAL
    default 10

endif # SHIELD_ORBAYU_LEFT || SHIELD_ORBAYU_RIGHT

if SHIELD_ORBAYU_DONGLE

config ZMK_KEYBOARD_NAME
    default "Orbayu"

config ZMK_SPLIT_ROLE_CENTRAL
    default y

config ZMK_SPLIT
    default y

config ZMK_SPLIT_BLE_CENTRAL_PERIPHERALS
    default 2

config ZMK_BLE
    default y

endif # SHIELD_ORBAYU_DONGLE
```

## boards/shields/orbayu/Kconfig.shield
```kconfig
config SHIELD_ORBAYU_LEFT
    def_bool $(shields_list_contains,orbayu_left)

config SHIELD_ORBAYU_RIGHT
    def_bool $(shields_list_contains,orbayu_right)

config SHIELD_ORBAYU_DONGLE
    def_bool $(shields_list_contains,orbayu_dongle)
```

## config/west.yml
```yaml
manifest:
  defaults:
    revision: main
  remotes:
    - name: zmkfirmware
      url-base: https://github.com/zmkfirmware
    - name: sekigon-gonnoc # <-- PAW3222
      url-base: https://github.com/sekigon-gonnoc
    - name: caksoylar # <-- RGB LED
      url-base: https://github.com/caksoylar
    - name: carrefinho # <-- Prospector dongle
      url-base: https://github.com/carrefinho
  projects:
    - name: zmk
      remote: zmkfirmware
      import: app/west.yml
    - name: zmk-driver-paw3222
      remote: sekigon-gonnoc
      revision: main
    - name: zmk-rgbled-widget
      remote: caksoylar
      revision: main
    - name: prospector-zmk-module
      remote: carrefinho
      revision: feat/new-status-screens
  self:
    path: config
```
